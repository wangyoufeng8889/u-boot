## board/freescale/mx6ullalpha/Kconfig
```kconfig
if TARGET_MX6ULL_14X14_EVK

config SYS_BOARD
	default "mx6ullalpha"

config SYS_VENDOR
	default "freescale"

config SYS_CONFIG_NAME
	default "mx6ullalpha"

endif
```
